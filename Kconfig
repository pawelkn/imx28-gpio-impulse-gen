## Kconfig
```kconfig
config IMX28_GPIO_IMPULSE_GEN
   bool "i.MX28 GPIO impulse generator"
   depends on SOC_IMX28 && ( GPIOLIB || COMPILE_TEST )
   select FIQ
   default n
   help
     Say Y here to add the driver.
```
